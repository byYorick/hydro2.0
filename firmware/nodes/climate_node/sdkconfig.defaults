## firmware/nodes/climate_node/sdkconfig.defaults
```kconfig
# Default SDK configuration for climate_node

# Enable Wi-Fi
CONFIG_ESP_WIFI_STATIC_RX_BUFFER_NUM=10
CONFIG_ESP_WIFI_DYNAMIC_RX_BUFFER_NUM=32

# Enable MQTT
CONFIG_MQTT_PROTOCOL_311=y
CONFIG_MQTT_TRANSPORT_SSL=y
CONFIG_MQTT_TRANSPORT_WEBSOCKET=y

# FreeRTOS
CONFIG_FREERTOS_HZ=1000
CONFIG_FREERTOS_USE_TRACE_FACILITY=y

# Logging
CONFIG_LOG_DEFAULT_LEVEL_INFO=y
CONFIG_LOG_MAXIMUM_LEVEL_VERBOSE=y

# Partition Table - использовать кастомную таблицу разделов
CONFIG_PARTITION_TABLE_CUSTOM=y
CONFIG_PARTITION_TABLE_CUSTOM_FILENAME="partitions.csv"
CONFIG_PARTITION_TABLE_SINGLE_APP=n
```

## firmware/nodes/common/components/node_framework/Kconfig
```kconfig
menu "Hydro Node Framework"

config HYDRO_ALLOW_LEGACY_HMAC
    bool "Allow commands without HMAC (ts/sig)"
    default n
    help
        When enabled, incoming MQTT commands without ts/sig fields may be accepted
        if NodeConfig allow_legacy_hmac is also true. Production builds must keep
        this disabled (default).

endmenu
```

## firmware/nodes/ec_node/sdkconfig.defaults
```kconfig
# Default SDK configuration for ec_node

# Flash/partition profile: ESP32, 4MB flash, single factory app 1792K
CONFIG_ESPTOOLPY_FLASHMODE_DIO=y
CONFIG_ESPTOOLPY_FLASHMODE="dio"
CONFIG_ESPTOOLPY_FLASHFREQ_40M=y
CONFIG_ESPTOOLPY_FLASHFREQ="40m"
CONFIG_ESPTOOLPY_FLASHSIZE_4MB=y
CONFIG_ESPTOOLPY_FLASHSIZE="4MB"
CONFIG_PARTITION_TABLE_CUSTOM=y
CONFIG_PARTITION_TABLE_CUSTOM_FILENAME="partitions.csv"
CONFIG_PARTITION_TABLE_FILENAME="partitions.csv"
CONFIG_PARTITION_TABLE_OFFSET=0x8000
CONFIG_PARTITION_TABLE_MD5=y

# Enable Wi-Fi
CONFIG_ESP_WIFI_STATIC_RX_BUFFER_NUM=10
CONFIG_ESP_WIFI_DYNAMIC_RX_BUFFER_NUM=32

# Enable MQTT transport profile used by mqtt_manager (mqtt:// and mqtts:// only)
CONFIG_MQTT_PROTOCOL_311=y
CONFIG_MQTT_TRANSPORT_SSL=y
# CONFIG_MQTT_TRANSPORT_WEBSOCKET is not set
# CONFIG_MQTT_TRANSPORT_WEBSOCKET_SECURE is not set

# FreeRTOS
CONFIG_FREERTOS_HZ=1000
CONFIG_FREERTOS_USE_TRACE_FACILITY=y

# Logging / build profile
CONFIG_LOG_DEFAULT_LEVEL_INFO=y
CONFIG_LOG_DEFAULT_LEVEL=3
CONFIG_LOG_MAXIMUM_LEVEL_INFO=y
CONFIG_LOG_MAXIMUM_LEVEL=3
CONFIG_COMPILER_OPTIMIZATION_SIZE=y
CONFIG_COMPILER_OPTIMIZATION_ASSERTIONS_DISABLE=y
CONFIG_COMPILER_OPTIMIZATION_ASSERTION_LEVEL=0

# Task Watchdog Configuration
CONFIG_ESP_TASK_WDT_CHECK_IDLE_TASK_CPU0=n
CONFIG_ESP_TASK_WDT_CHECK_IDLE_TASK_CPU1=n
CONFIG_ESP_TASK_WDT_TIMEOUT_S=10
```

## firmware/nodes/light_node/sdkconfig.defaults
```kconfig
# ESP32C3 target
CONFIG_IDF_TARGET="esp32c3"

# Flash size
CONFIG_ESPTOOLPY_FLASHSIZE_4MB=y
CONFIG_ESPTOOLPY_FLASHSIZE="4MB"

# Partition table
CONFIG_PARTITION_TABLE_CUSTOM=y
CONFIG_PARTITION_TABLE_CUSTOM_FILENAME="partitions.csv"
CONFIG_PARTITION_TABLE_FILENAME="partitions.csv"

# FreeRTOS
CONFIG_FREERTOS_USE_TRACE_FACILITY=y
```

## firmware/nodes/ph_node/sdkconfig.defaults
```kconfig
# Default SDK configuration for ph_node

# Enable Wi-Fi
CONFIG_ESP32_WIFI_STATIC_RX_BUFFER_NUM=10
CONFIG_ESP32_WIFI_DYNAMIC_RX_BUFFER_NUM=32

# Enable MQTT
CONFIG_MQTT_PROTOCOL_311=y
CONFIG_MQTT_TRANSPORT_SSL=y
CONFIG_MQTT_TRANSPORT_WEBSOCKET=y

# FreeRTOS
CONFIG_FREERTOS_HZ=1000

# Logging
CONFIG_LOG_DEFAULT_LEVEL_INFO=y
CONFIG_LOG_MAXIMUM_LEVEL_VERBOSE=y

# GPIO Configuration for pumps
# GPIO pins for pump control (can be overridden in code via NodeConfig)
# Default values: pump_acid = GPIO 12, pump_base = GPIO 13
# These can be configured via hardware.gpio in NodeConfig JSON
CONFIG_PH_NODE_PUMP_ACID_GPIO=12
CONFIG_PH_NODE_PUMP_BASE_GPIO=13

# I2C Configuration
# I2C pins for sensors and OLED (can be overridden in code via NodeConfig)
# Default values: SDA = GPIO 8, SCL = GPIO 9
# These can be configured via hardware.i2c in NodeConfig JSON
CONFIG_PH_NODE_I2C_SDA_GPIO=8
CONFIG_PH_NODE_I2C_SCL_GPIO=9

# Flash size
CONFIG_ESPTOOLPY_FLASHSIZE_4MB=y

# Partition Table
CONFIG_PARTITION_TABLE_SINGLE_APP=n
CONFIG_PARTITION_TABLE_CUSTOM=y
CONFIG_PARTITION_TABLE_CUSTOM_FILENAME="partitions.csv"

# Task Watchdog Configuration
# Отключаем проверку idle задач, так как они не могут сбрасывать watchdog
# и это вызывает ложные срабатывания
CONFIG_ESP_TASK_WDT_CHECK_IDLE_TASK_CPU0=n
CONFIG_ESP_TASK_WDT_CHECK_IDLE_TASK_CPU1=n
# Устанавливаем таймаут 10 секунд (согласно DEVICE_NODE_PROTOCOL.md)
CONFIG_ESP_TASK_WDT_TIMEOUT_S=10
```

## firmware/nodes/pump_node/sdkconfig.defaults
```kconfig
# Partition table: 1792K factory
CONFIG_PARTITION_TABLE_CUSTOM=y
CONFIG_PARTITION_TABLE_CUSTOM_FILENAME="partitions.csv"
CONFIG_PARTITION_TABLE_FILENAME="partitions.csv"
CONFIG_PARTITION_TABLE_OFFSET=0x8000
CONFIG_PARTITION_TABLE_MD5=y

# FreeRTOS
CONFIG_FREERTOS_USE_TRACE_FACILITY=y
```

## firmware/nodes/relay_node/sdkconfig.defaults
```kconfig
# Конфигурация для relay_node

# WiFi - агрессивная оптимизация памяти
CONFIG_ESP_WIFI_STATIC_RX_BUFFER_NUM=5
CONFIG_ESP_WIFI_DYNAMIC_RX_BUFFER_NUM=16
CONFIG_ESP_WIFI_TX_BUFFER=8
CONFIG_ESP_WIFI_RX_BA_WIN=8
CONFIG_ESP_WIFI_DYNAMIC_TX_BUFFER_NUM=16

# MQTT
CONFIG_MQTT_PROTOCOL_311=y

# Logging
CONFIG_LOG_DEFAULT_LEVEL_INFO=y
CONFIG_LOG_MAXIMUM_LEVEL_VERBOSE=y

# FreeRTOS
CONFIG_FREERTOS_HZ=1000

# Partition Table
CONFIG_PARTITION_TABLE_CUSTOM=y
CONFIG_PARTITION_TABLE_CUSTOM_FILENAME="partitions.csv"

# Оптимизация памяти для уменьшения использования DRAM
CONFIG_ESP_DEFAULT_CPU_FREQ_MHZ_240=y
CONFIG_ESP_DEFAULT_CPU_FREQ_MHZ=240
CONFIG_SPIRAM=n

# Оптимизация heap
CONFIG_HEAP_POISONING_COMPREHENSIVE=n
CONFIG_HEAP_POISONING_LIGHT=n
CONFIG_HEAP_POISONING_DISABLED=y
CONFIG_HEAP_TRACING_OFF=y

# Оптимизация логов
CONFIG_LOG_MAXIMUM_EQUALS_DEFAULT=y

# Оптимизация компонентов
CONFIG_ESP_ERR_TO_NAME_LOOKUP=n
CONFIG_ESP_SYSTEM_EVENT_TASK_STACK_SIZE=1536

# Оптимизация компилятора для уменьшения размера
CONFIG_COMPILER_OPTIMIZATION_SIZE=y
CONFIG_COMPILER_OPTIMIZATION_PERF=n
CONFIG_COMPILER_OPTIMIZATION_ASSERTIONS_ENABLE=n
CONFIG_COMPILER_OPTIMIZATION_ASSERTIONS_SILENT=n
CONFIG_COMPILER_OPTIMIZATION_ASSERTIONS_DEBUG=n
CONFIG_COMPILER_OPTIMIZATION_LEVEL_DEBUG=n
CONFIG_COMPILER_OPTIMIZATION_LEVEL_RELEASE=y
CONFIG_COMPILER_OPTIMIZATION_NONE=n
CONFIG_COMPILER_OPTIMIZATION_PERF_DEBUG=n
CONFIG_COMPILER_OPTIMIZATION_PERF_RELEASE=n
CONFIG_COMPILER_OPTIMIZATION_SIZE_DEBUG=n
CONFIG_COMPILER_OPTIMIZATION_SIZE_RELEASE=y
CONFIG_COMPILER_OPTIMIZATION_ASSERTION_LEVEL=0

# Дополнительные оптимизации памяти
CONFIG_ESP_WIFI_AMPDU_TX_ENABLED=n
CONFIG_ESP_WIFI_AMPDU_RX_ENABLED=n
CONFIG_ESP_WIFI_AMSDU_TX_ENABLED=n
CONFIG_ESP_WIFI_NVS_ENABLED=y
CONFIG_ESP_WIFI_TX_BUFFER_TYPE=1

# Оптимизация MQTT
CONFIG_MQTT_OUTBOX_EXPIRED_TIMEOUT_MS=30000

# Оптимизация TLS/SSL
CONFIG_MBEDTLS_CERTIFICATE_BUNDLE=n
CONFIG_MBEDTLS_CERTIFICATE_BUNDLE_DEFAULT_FULL=n
CONFIG_MBEDTLS_CERTIFICATE_BUNDLE_DEFAULT_CMN=n

# Оптимизация NVS
CONFIG_NVS_ENCRYPTION=n

# Оптимизация LWIP
CONFIG_LWIP_MAX_SOCKETS=8
CONFIG_LWIP_SO_REUSE=y
CONFIG_LWIP_SO_REUSE_RXTOALL=n
CONFIG_LWIP_SO_RCVBUF=n
CONFIG_LWIP_DHCP_MAX_NTP_SERVERS=1
CONFIG_LWIP_DHCP_DOES_ARP_CHECK=n
CONFIG_LWIP_TCP_MSS=1440
CONFIG_LWIP_TCP_SND_BUF_DEFAULT=5744
CONFIG_LWIP_TCP_WND_DEFAULT=5744
CONFIG_LWIP_TCP_RECVMBOX_SIZE=6
CONFIG_LWIP_UDP_RECVMBOX_SIZE=6
CONFIG_LWIP_TCPIP_RECVMBOX_SIZE=32

# Оптимизация FreeRTOS
CONFIG_FREERTOS_ASSERT_ON_UNTESTED_FUNCTION=n
CONFIG_FREERTOS_CHECK_STACKOVERFLOW_NONE=y
CONFIG_FREERTOS_CHECK_STACKOVERFLOW_CANARY=n
CONFIG_FREERTOS_CHECK_STACKOVERFLOW_PTRVAL=n
CONFIG_FREERTOS_CHECK_MUTEX_GIVEN_BY_OWNER=n
CONFIG_FREERTOS_USE_TRACE_FACILITY=y
CONFIG_FREERTOS_USE_STATS_FORMATTING_FUNCTIONS=n
CONFIG_FREERTOS_GENERATE_RUN_TIME_STATS=n
CONFIG_FREERTOS_TASK_FUNCTION_WRAPPER=n
CONFIG_FREERTOS_WATCHPOINT_END_OF_STACK=n

# Оптимизация памяти приложений
CONFIG_ESP_MAIN_TASK_STACK_SIZE=3072
CONFIG_ESP_SYSTEM_EVENT_TASK_STACK_SIZE=1536
CONFIG_ESP_TIMER_TASK_STACK_SIZE=2048
CONFIG_ESP_INT_WDT_TIMEOUT_MS=800
CONFIG_ESP_TASK_WDT_TIMEOUT_S=10
CONFIG_ESP_TASK_WDT_CHECK_IDLE_TASK_CPU0=n
CONFIG_ESP_TASK_WDT_CHECK_IDLE_TASK_CPU1=n

# Отключение неиспользуемых функций
CONFIG_ESP_COREDUMP_ENABLE_TO_NONE=y
CONFIG_ESP_ERR_TO_NAME_LOOKUP=n
CONFIG_ESP_SYSTEM_EVENT_QUEUE_SIZE=32
CONFIG_ESP_SYSTEM_EVENT_TASK_PRIORITY=5
```

## firmware/nodes/storage_irrigation_node/sdkconfig.defaults
```kconfig
# Flash/partition profile: ESP32, 4MB flash, single factory app 1792K
CONFIG_ESPTOOLPY_FLASHMODE_DIO=y
CONFIG_ESPTOOLPY_FLASHMODE="dio"
CONFIG_ESPTOOLPY_FLASHFREQ_40M=y
CONFIG_ESPTOOLPY_FLASHFREQ="40m"
# CONFIG_ESPTOOLPY_FLASHSIZE_2MB is not set
CONFIG_ESPTOOLPY_FLASHSIZE_4MB=y
CONFIG_ESPTOOLPY_FLASHSIZE="4MB"
CONFIG_PARTITION_TABLE_CUSTOM=y
CONFIG_PARTITION_TABLE_CUSTOM_FILENAME="partitions.csv"
CONFIG_PARTITION_TABLE_FILENAME="partitions.csv"
CONFIG_PARTITION_TABLE_OFFSET=0x8000
CONFIG_PARTITION_TABLE_MD5=y

# MQTT transport profile used by mqtt_manager (mqtt:// and mqtts:// only)
CONFIG_MQTT_PROTOCOL_311=y
CONFIG_MQTT_TRANSPORT_SSL=y
# CONFIG_MQTT_TRANSPORT_WEBSOCKET is not set
# CONFIG_MQTT_TRANSPORT_WEBSOCKET_SECURE is not set

# Runtime/FreeRTOS
CONFIG_FREERTOS_HZ=100
CONFIG_FREERTOS_USE_TRACE_FACILITY=y
CONFIG_ESP_MAIN_TASK_STACK_SIZE=6144
CONFIG_ESP_SYSTEM_EVENT_TASK_STACK_SIZE=3072
CONFIG_ESP_TIMER_TASK_STACK_SIZE=4096
CONFIG_LWIP_TCPIP_TASK_STACK_SIZE=4096

# Watchdogs: node runtime uses explicit task registration/reset
CONFIG_ESP_INT_WDT_TIMEOUT_MS=800
CONFIG_ESP_TASK_WDT_TIMEOUT_S=10
CONFIG_ESP_TASK_WDT_CHECK_IDLE_TASK_CPU0=n
CONFIG_ESP_TASK_WDT_CHECK_IDLE_TASK_CPU1=n

# Logging
CONFIG_LOG_DEFAULT_LEVEL_INFO=y
CONFIG_LOG_DEFAULT_LEVEL=3
CONFIG_LOG_MAXIMUM_LEVEL_INFO=y
CONFIG_LOG_MAXIMUM_LEVEL=3

# Build profile: release-size, no debug optimization
CONFIG_COMPILER_OPTIMIZATION_SIZE=y
CONFIG_COMPILER_OPTIMIZATION_PERF=n
CONFIG_COMPILER_OPTIMIZATION_ASSERTIONS_ENABLE=y
CONFIG_COMPILER_OPTIMIZATION_NONE=n
CONFIG_COMPILER_OPTIMIZATION_DEBUG=n
CONFIG_COMPILER_OPTIMIZATION_ASSERTION_LEVEL=2
```

## firmware/test_node/main/Kconfig.projbuild
```kconfig
menu "Test Node UI"

config TEST_NODE_UI_ENABLE
    bool "Enable local UI (ILI9341 + LVGL + encoder)"
    default y

config TEST_NODE_LCD_H_RES
    int "ILI9341 horizontal resolution"
    default 240
    range 1 480

config TEST_NODE_LCD_V_RES
    int "ILI9341 vertical resolution"
    default 320
    range 1 480

config TEST_NODE_LCD_BUFFER_LINES
    int "LVGL draw buffer lines"
    default 20
    range 10 120

config TEST_NODE_LCD_PIXEL_CLOCK_HZ
    int "LCD SPI pixel clock (Hz)"
    default 20000000
    range 1000000 40000000

config TEST_NODE_LCD_IO_QUEUE_DEPTH
    int "LCD SPI transaction queue depth"
    default 10
    range 1 10

config TEST_NODE_LCD_SINGLE_BUFFER
    bool "Use single LVGL draw buffer (more stable, lower RAM)"
    default n

config TEST_NODE_LCD_SWAP_COLOR_BYTES
    bool "LVGL RGB565 byte order swap (for some ILI9341 boards)"
    default y

config TEST_NODE_LCD_RGB_ORDER_BGR
    bool "LCD RGB element order: BGR (ILI9341 typical)"
    default y

config TEST_NODE_LCD_SWAP_XY
    bool "LCD swap X/Y axes"
    default n

config TEST_NODE_LCD_MIRROR_X
    bool "LCD mirror X"
    default y

config TEST_NODE_LCD_MIRROR_Y
    bool "LCD mirror Y"
    default n

config TEST_NODE_LCD_INVERT_COLORS
    bool "LCD invert colors"
    default n

config TEST_NODE_LCD_PIN_SCLK
    int "LCD SPI SCLK GPIO"
    default 12
    range -1 48

config TEST_NODE_LCD_PIN_MOSI
    int "LCD SPI MOSI GPIO"
    default 11
    range -1 48

config TEST_NODE_LCD_PIN_MISO
    int "LCD SPI MISO GPIO (-1 if unused)"
    default -1
    range -1 48

config TEST_NODE_LCD_PIN_DC
    int "LCD DC GPIO"
    default 9
    range -1 48

config TEST_NODE_LCD_PIN_RST
    int "LCD RESET GPIO"
    default 14
    range -1 48

config TEST_NODE_LCD_PIN_CS
    int "LCD CS GPIO"
    default 10
    range -1 48

config TEST_NODE_LCD_PIN_BK_LIGHT
    int "LCD backlight GPIO"
    default 15
    range -1 48

config TEST_NODE_LCD_BK_LIGHT_ON_LEVEL
    int "LCD backlight ON level"
    default 1
    range 0 1

config TEST_NODE_ENCODER_PIN_A
    int "Encoder pin A (CLK)"
    default 5
    range 0 48

config TEST_NODE_ENCODER_PIN_B
    int "Encoder pin B (DT)"
    default 4
    range 0 48

config TEST_NODE_ENCODER_PIN_SW
    int "Encoder pin SW"
    default 6
    range 0 48

endmenu
```
