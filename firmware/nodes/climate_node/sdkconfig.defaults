## firmware/test_node/sdkconfig.defaults
```kconfig
# Конфигурация для тестовой ноды

# Target
CONFIG_IDF_TARGET="esp32s3"

# WiFi
CONFIG_ESP_WIFI_STATIC_RX_BUFFER_NUM=10
CONFIG_ESP_WIFI_DYNAMIC_RX_BUFFER_NUM=32

# MQTT
CONFIG_MQTT_PROTOCOL_311=y

# Logging
CONFIG_LOG_DEFAULT_LEVEL_INFO=y
CONFIG_LOG_MAXIMUM_LEVEL_VERBOSE=y

# FreeRTOS
CONFIG_FREERTOS_HZ=1000

# Partition Table
CONFIG_PARTITION_TABLE_CUSTOM=y
CONFIG_PARTITION_TABLE_CUSTOM_FILENAME="partitions.csv"
CONFIG_ESPTOOLPY_FLASHSIZE_4MB=y
CONFIG_ESPTOOLPY_FLASHSIZE="4MB"

# Оптимизация памяти для уменьшения использования DRAM
CONFIG_SPIRAM=n

# Оптимизация heap
CONFIG_HEAP_POISONING_COMPREHENSIVE=n
CONFIG_HEAP_POISONING_LIGHT=n
CONFIG_HEAP_POISONING_DISABLED=y
CONFIG_HEAP_TRACING_OFF=y

# Оптимизация логов
CONFIG_LOG_MAXIMUM_EQUALS_DEFAULT=y

# Оптимизация компонентов
CONFIG_ESP_ERR_TO_NAME_LOOKUP=n
CONFIG_ESP_SYSTEM_EVENT_TASK_STACK_SIZE=4096
CONFIG_ESP_MAIN_TASK_STACK_SIZE=4096

# Local UI: ILI9341 + LVGL + encoder (aligned with esp-idf spi_lcd_touch)
CONFIG_TEST_NODE_UI_ENABLE=y
CONFIG_TEST_NODE_LCD_H_RES=240
CONFIG_TEST_NODE_LCD_V_RES=320
CONFIG_TEST_NODE_LCD_BUFFER_LINES=20
CONFIG_TEST_NODE_LCD_PIXEL_CLOCK_HZ=20000000
CONFIG_TEST_NODE_LCD_IO_QUEUE_DEPTH=10
# CONFIG_TEST_NODE_LCD_SINGLE_BUFFER is not set
CONFIG_TEST_NODE_LCD_RGB_ORDER_BGR=y
CONFIG_TEST_NODE_LCD_SWAP_COLOR_BYTES=y
CONFIG_TEST_NODE_LCD_SWAP_XY=n
CONFIG_TEST_NODE_LCD_MIRROR_X=y
CONFIG_TEST_NODE_LCD_MIRROR_Y=n
CONFIG_TEST_NODE_LCD_INVERT_COLORS=n
CONFIG_TEST_NODE_LCD_PIN_SCLK=12
CONFIG_TEST_NODE_LCD_PIN_MOSI=11
CONFIG_TEST_NODE_LCD_PIN_MISO=-1
CONFIG_TEST_NODE_LCD_PIN_DC=9
CONFIG_TEST_NODE_LCD_PIN_RST=14
CONFIG_TEST_NODE_LCD_PIN_CS=10
CONFIG_TEST_NODE_LCD_PIN_BK_LIGHT=15
CONFIG_TEST_NODE_LCD_BK_LIGHT_ON_LEVEL=1
CONFIG_TEST_NODE_ENCODER_PIN_A=5
CONFIG_TEST_NODE_ENCODER_PIN_B=4
CONFIG_TEST_NODE_ENCODER_PIN_SW=6

# LVGL optimization: максимально облегчённый профиль для test_node UI
CONFIG_LV_CONF_SKIP=y
CONFIG_LV_CONF_MINIMAL=y
CONFIG_LV_COLOR_DEPTH_16=y
CONFIG_LV_MEM_SIZE_KILOBYTES=32
CONFIG_LV_MEM_POOL_EXPAND_SIZE_KILOBYTES=0
CONFIG_LV_DEF_REFR_PERIOD=40
CONFIG_LV_DRAW_LAYER_SIMPLE_BUF_SIZE=12288
CONFIG_LV_DRAW_SW_SUPPORT_RGB565=y
# CONFIG_LV_DRAW_SW_SUPPORT_RGB565A8 is not set
# CONFIG_LV_DRAW_SW_SUPPORT_RGB888 is not set
# CONFIG_LV_DRAW_SW_SUPPORT_XRGB8888 is not set
# CONFIG_LV_DRAW_SW_SUPPORT_ARGB8888 is not set
# CONFIG_LV_DRAW_SW_SUPPORT_L8 is not set
# CONFIG_LV_DRAW_SW_SUPPORT_AL88 is not set
# CONFIG_LV_DRAW_SW_SUPPORT_A8 is not set
# CONFIG_LV_DRAW_SW_SUPPORT_I1 is not set
CONFIG_LV_DRAW_SW_COMPLEX=y
CONFIG_LV_DRAW_SW_CIRCLE_CACHE_SIZE=0
# CONFIG_LV_USE_ASSERT_NULL is not set
# CONFIG_LV_USE_ASSERT_MALLOC is not set
CONFIG_LV_BUILD_EXAMPLES=n
CONFIG_LV_FONT_MONTSERRAT_12=y
# CONFIG_LV_FONT_MONTSERRAT_14 is not set
CONFIG_LV_FONT_DEFAULT_MONTSERRAT_12=y
# CONFIG_LV_USE_FONT_PLACEHOLDER is not set
CONFIG_LV_USE_LABEL=y
# CONFIG_LV_LABEL_TEXT_SELECTION is not set
# CONFIG_LV_LABEL_LONG_TXT_HINT is not set
# CONFIG_LV_USE_ANIMIMG is not set
# CONFIG_LV_USE_ARC is not set
# CONFIG_LV_USE_BAR is not set
# CONFIG_LV_USE_BUTTON is not set
# CONFIG_LV_USE_BUTTONMATRIX is not set
# CONFIG_LV_USE_CALENDAR is not set
# CONFIG_LV_USE_CANVAS is not set
# CONFIG_LV_USE_CHART is not set
# CONFIG_LV_USE_CHECKBOX is not set
# CONFIG_LV_USE_DROPDOWN is not set
# CONFIG_LV_USE_IMAGE is not set
# CONFIG_LV_USE_IMAGEBUTTON is not set
# CONFIG_LV_USE_KEYBOARD is not set
# CONFIG_LV_USE_LED is not set
# CONFIG_LV_USE_LINE is not set
# CONFIG_LV_USE_LIST is not set
# CONFIG_LV_USE_MENU is not set
# CONFIG_LV_USE_MSGBOX is not set
# CONFIG_LV_USE_ROLLER is not set
# CONFIG_LV_USE_SCALE is not set
# CONFIG_LV_USE_SLIDER is not set
# CONFIG_LV_USE_SPAN is not set
# CONFIG_LV_USE_SPINBOX is not set
# CONFIG_LV_USE_SPINNER is not set
# CONFIG_LV_USE_SWITCH is not set
# CONFIG_LV_USE_TEXTAREA is not set
# CONFIG_LV_USE_TABLE is not set
# CONFIG_LV_USE_TABVIEW is not set
# CONFIG_LV_USE_TILEVIEW is not set
# CONFIG_LV_USE_WIN is not set
# CONFIG_LV_USE_THEME_DEFAULT is not set
# CONFIG_LV_USE_THEME_SIMPLE is not set
# CONFIG_LV_USE_FLEX is not set
# CONFIG_LV_USE_GRID is not set
# CONFIG_LV_USE_OBSERVER is not set
```
